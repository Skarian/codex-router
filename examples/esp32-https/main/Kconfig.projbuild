## examples/esp32-https/main/Kconfig.projbuild
```kconfig
menu "Codex Router example"
config ROUTER_ORIGIN
    string "HTTPS origin (no trailing slash)"
    default "https://router.example.com"
config ROUTER_PRIVATE_CA
    bool "Trust a private CA from main/router_ca.pem"
    default n
    help
        Embed the PEM CA certificate for a LAN gateway. Server hostname
        verification remains enabled. Copy only the CA certificate into
        main/router_ca.pem; never copy a private key. When disabled, the
        client uses the ESP certificate bundle.
config ROUTER_AGENT
    string "Configured agent ID"
    default "assistant"
config ROUTER_USERNAME
    string "Proxy Basic username (development only)"
    default "router"
config ROUTER_PASSWORD
    string "Proxy Basic password (development only; provision securely for deployment)"
    default "REPLACE_ME"
config ROUTER_PROMPT
    string "Prompt submitted once (up to 1024 UTF-8 bytes)"
    default "Explain the current project status."
endmenu
```

## examples/esp32-https/sdkconfig.defaults
```kconfig
CONFIG_MBEDTLS_CERTIFICATE_BUNDLE=y
CONFIG_MBEDTLS_CERTIFICATE_BUNDLE_DEFAULT_FULL=y
CONFIG_ESP_MAIN_TASK_STACK_SIZE=8192
```
